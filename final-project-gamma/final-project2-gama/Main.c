// Lab3.c
// Runs on LM4F120/TM4C123
// Real Time Operating System for Lab 3

// Jonathan W. Valvano 2/20/17, valvano@mail.utexas.edu
// Modified by Sile Shu 10/4/17, ss5de@virginia.edu
// You may use, edit, run or distribute this file
// You are free to change the syntax/organization of this file


#include <stdint.h>
#include "OS.h"
#include "tm4c123gh6pm.h"
#include "LCD.h"
#include <string.h>
#include "FIFO.h"
#include "joystick.h"
#include <stdlib.h>
//constants
#define CROSSSIZE            5
#define PERIOD               4000000   // DAS 20Hz sampling period in system time units
#define LIFETIME             1000
#define BGCOLOR              LCD_BLACK
#define MAXCUBES             5
#define POLY_MASK_32         0xB4BCD35C
#define POLY_MASK_31         0x7A5BC2E3
#define VERTICALNUM          8
#define HORIZONTALNUM        8
#define UP                   0
#define LEFT                 1
#define RIGHT                2
#define DOWN                 3
#define CUBELIFEDURATION     45
#define SHOTSPEED            100

extern Sema4Type LCDFree;
uint16_t origin[2]; // the original ADC value of x,y if the joystick is not touched
int16_t x = 63;  // horizontal position of the crosshair, initially 63
int16_t y = 63;  // vertical position of the crosshair, initially 63
int16_t prevx,prevy;
uint8_t select;  // joystick push
uint8_t area[2];

uint16_t Cube_Colors[] = {LCD_RED, LCD_BLUE, LCD_GREEN, LCD_YELLOW, LCD_MAGENTA, LCD_CYAN, LCD_WHITE, LCD_GREY};  //colors for cubes

Sema4Type scoreSema;
Sema4Type Trace;
Sema4Type Trace1;
Sema4Type blockConsumer;
Sema4Type lifeSema;

unsigned long NumCreated;   // number of foreground threads created
unsigned long NumSamples;   // incremented every ADC sample, in Producer
unsigned long CubeSamples;  // incremented every ADC sample, in Producer -- for cubes
unsigned long CubeCount= 0; // count of total active cubes
char life = 3;              // remaining lives
unsigned long score = 0;    // total cubes hit (1 per hit)
unsigned long shotnum = 0;  // Number of Player current shots
unsigned long startup = 0;
unsigned int enemyNumber = 0;
unsigned int flaggin = 0;
unsigned char mode = 0;      // 0 -> ScoreAttack, 1-> Classic
unsigned char insplash = 0;
int start = 1;
//prototypes
void PlayerShot(void);

//Structures
typedef struct {
    int position[2];  // Postion[0] = Horizontal (x), Position[1] = Vertical (y)
    Sema4Type ShotFree;	 // free = 0, occupied = 1
} shot;

shot Shot;

typedef struct {
    int position[2];  // Postion[0] = Horizontal (x), Position[1] = Vertical (y)
    int alive;
    uint16_t * color;
} enemy;

enemy Enemy;

#define enemyNum 8
enemy enemyArray[enemyNum];

typedef struct {
    int position[2];  // Postion[0] = Horizontal (x), Position[1] = Vertical (y)
    int alive;
    uint16_t * color;
} enemyclassic;

enemyclassic EnemyClassic;


enemyclassic enemyArrayClassic[enemyNum][enemyNum]; //[Row][Column]

//--------------------------------Bitmaps-------------------
const uint16_t ship[] = {
    0x0000, 0xce79, 0x0000, 0x0000, 0x0000, 0x0000, 0x0000, 0x0000, 0xce79, 0x0000, 0x0000, 0x0000, 0x0000, 0x0000, 0x0000, 0xce79,
    0x0000, 0xce79, 0xce79, 0x0000, 0x0000, 0xf800, 0xf800, 0x0000, 0xce79, 0x0000, 0xf800, 0xf800, 0x0000, 0x0000, 0xce79, 0xce79,
    0x0000, 0xce79, 0xce79, 0xce79, 0x0000, 0xf800, 0xf800, 0xce79, 0xce79, 0xce79, 0xf800, 0xf800, 0x0000, 0xce79, 0xce79, 0xce79,
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    0x0000, 0x0000, 0x0000, 0x0000, 0x0000, 0x0000, 0x0000, 0x0000, 0xce79, 0x0000, 0x0000, 0x0000, 0x0000, 0x0000, 0x0000, 0x0000

};

uint16_t enemies[4][256] = {{
        0x0000, 0x0000, 0x0000, 0x0000, 0x0000, 0x0000, 0x0000, 0x0000, 0x0000, 0x0000, 0x0000, 0x0000, 0x0000, 0x0000, 0x0000, 0x0000,
        0x0000, 0x0000, 0x0000, 0x0000, 0x0000, 0x0000, 0x0000, 0x04b2, 0x0000, 0x04b2, 0x0000, 0x0000, 0x0000, 0x0000, 0x0000, 0x0000,
        0x0000, 0x0000, 0x0000, 0x0000, 0x0000, 0x0000, 0x04b2, 0x04b2, 0x0000, 0x04b2, 0x04b2, 0x0000, 0x0000, 0x0000, 0x0000, 0x0000,
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        0x0000, 0x0000, 0x0000, 0x0000, 0x0000, 0x0000, 0x0000, 0x04b2, 0x0000, 0x04b2, 0x0000, 0x0000, 0x0000, 0x0000, 0x0000, 0x0000
    },
    {   0x0000, 0x0000, 0x0000, 0x0000, 0x0000, 0x0000, 0x0000, 0x035b, 0x0000, 0x035b, 0x0000, 0x0000, 0x0000, 0x0000, 0x0000, 0x0000,
        0x0000, 0x0000, 0x0000, 0x0000, 0x0000, 0x0000, 0x035b, 0x035b, 0x0000, 0x035b, 0x035b, 0x0000, 0x0000, 0x0000, 0x0000, 0x0000,
        0x0000, 0x0000, 0x0000, 0x0000, 0x0000, 0x035b, 0x035b, 0x0000, 0x0000, 0x0000, 0x035b, 0x035b, 0x0000, 0x0000, 0x0000, 0x0000,
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        0x0000, 0x0000, 0x0000, 0x0000, 0x0000, 0x0000, 0x0000, 0x0000, 0x0000, 0x0000, 0x0000, 0x0000, 0x0000, 0x0000, 0x0000, 0x0000
    }
    ,{
        0x0000, 0x0000, 0x0000, 0x0000, 0x0000, 0x0000, 0x0000, 0x0000, 0x0000, 0x0000, 0x0000, 0x0000, 0x0000, 0x0000, 0x0000, 0x0000,
        0x0000, 0x0000, 0x0000, 0x0000, 0x0000, 0x0000, 0x0000, 0x0000, 0x0000, 0x0000, 0x0000, 0x0000, 0x0000, 0x0000, 0x0000, 0x0000,
        0x0000, 0x0000, 0x0000, 0x0000, 0x0000, 0x0000, 0x0000, 0x0000, 0x0000, 0x0000, 0x0000, 0x0000, 0x0000, 0x0000, 0x0000, 0x0000,
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        0x0000, 0x0000, 0x0000, 0x0000, 0x0000, 0x0000, 0x0000, 0x0000, 0x0000, 0x0000, 0x0000, 0x0000, 0x0000, 0x0000, 0x0000, 0x0000
    },{
        0x0000, 0x0000, 0x0000, 0x0000, 0x0000, 0x0000, 0x0000, 0x0000, 0x0000, 0x0000, 0x0000, 0x0000, 0x0000, 0x0000, 0x0000, 0x0000,
        0x0000, 0x0000, 0x0000, 0x0000, 0x0000, 0x0000, 0x0000, 0x0000, 0x0000, 0x0000, 0x0000, 0x0000, 0x0000, 0x0000, 0x0000, 0x0000,
        0x0000, 0x0000, 0x0000, 0x0000, 0x0000, 0x0000, 0x0000, 0x0000, 0x0000, 0x0000, 0x0000, 0x0000, 0x0000, 0x0000, 0x0000, 0x0000,
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        0x0000, 0x0000, 0x0000, 0x0000, 0x0000, 0x0000, 0x0000, 0x0000, 0x0000, 0x0000, 0x0000, 0x0000, 0x0000, 0x0000, 0x0000, 0x0000
    }
};

const uint16_t logoTL [] = {
    0x0000, 0xb242, 0x7305, 0x4bc7, 0x53e6, 0xbb44, 0x81ea, 0x29ac, 0x214b, 0x29ed, 0x428e, 0x81eb, 0xba84, 0x4b45, 0x43c5, 0x4b24,
    0x0000, 0x68c1, 0xb364, 0x85cb, 0x85ca, 0xb446, 0x9188, 0x52d0, 0x320d, 0x214c, 0x214c, 0x4a6e, 0x9a2b, 0xa406, 0x85a8, 0xac45,
    0x0000, 0x0000, 0xba82, 0x8d09, 0x85ca, 0x94a8, 0xbaa5, 0x422d, 0x426f, 0x29cd, 0x320d, 0x4a6f, 0xb9e6, 0x9486, 0x85a9, 0xc363,
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    0x0000, 0x0000, 0x0000, 0x0000, 0x0000, 0x0000, 0x0000, 0x0000, 0x0000, 0x0000, 0x0000, 0x0000, 0x0000, 0x0000, 0x0000, 0x0000
};

const uint16_t logoT1 [] = {
    0xd324, 0xba26, 0x5304, 0x43a5, 0x8343, 0xb2e3, 0x3b44, 0x3b64, 0xbac2, 0x5a2e, 0xa168, 0x7b03, 0x2b64, 0x22e4, 0xcb01, 0x5860,
    0xa249, 0x99a9, 0xbb23, 0x84a7, 0x7da8, 0x7548, 0x8588, 0x85c8, 0xbb84, 0x628e, 0x9a4c, 0x9ca6, 0x8de8, 0x8587, 0xc301, 0x0000,
    0xd2e3, 0xb263, 0xb282, 0xa364, 0x7dc9, 0x7da8, 0x7d88, 0x7da8, 0xbbc4, 0x622d, 0x9a0c, 0x9c86, 0x85e8, 0x7d68, 0xdba1, 0xb2a2,
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    0x0000, 0x0000, 0x0000, 0x0000, 0x0000, 0x0000, 0x0000, 0x0000, 0x0000, 0x0000, 0x0000, 0x0000, 0x0000, 0x0000, 0x2840, 0x58a0
};
const uint16_t logoT2 [] = {
    0x8aa3, 0x2324, 0x6ac3, 0xcb02, 0x2ac4, 0x2344, 0xab23, 0x8aad, 0x9189, 0x8ae3, 0x2344, 0xb342, 0xb242, 0x7a83, 0x2344, 0x22c4,
    0xb262, 0x9c05, 0x85a8, 0x7d47, 0x7d47, 0x8dc8, 0xac65, 0x8969, 0x798b, 0xab64, 0x7d87, 0x84c6, 0xb2e2, 0xbb02, 0x7528, 0x7568,
    0xb281, 0xaae2, 0x7d47, 0x7da8, 0x7d88, 0x6c69, 0xa486, 0x9aa8, 0x520a, 0xc2a2, 0x7548, 0x7da8, 0x7d67, 0x7486, 0x7548, 0x7d88,
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    0x68a0, 0x70a0, 0x78a0, 0x78c0, 0x6080, 0x5861, 0x5061, 0x2800, 0x0000, 0x0000, 0x0000, 0x0000, 0x0000, 0x0000, 0x0000, 0x0000
};
const uint16_t logoTR [] = {
    0xbac2, 0x4a0d, 0x298d, 0x31ed, 0xba47, 0x42a4, 0x2325, 0x92a3, 0xb283, 0x2306, 0x22e5, 0xcb43, 0x4040, 0x0000, 0x60a1, 0x3860,
    0xa3e5, 0x7169, 0x29ad, 0x52cf, 0x816a, 0xcae2, 0x83e6, 0x7549, 0x6ca8, 0x7509, 0x7d2a, 0xc343, 0x4060, 0x0000, 0x0000, 0x0000,
    0x9466, 0x9167, 0xa188, 0xba67, 0xaa04, 0xaa82, 0x9426, 0x7589, 0x7569, 0x7d89, 0x85aa, 0xbb43, 0x4060, 0x0000, 0x0000, 0x0000,
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    0x0000, 0x0000, 0x0000, 0x0000, 0x0000, 0x0000, 0x0000, 0x0000, 0x0000, 0x0000, 0x0000, 0x0000, 0x0000, 0x0000, 0x0000, 0x0000
};

const uint16_t logoBL [] = {
    0x0000, 0x0000, 0x0000, 0x0000, 0x0000, 0x0000, 0x0000, 0x0000, 0x0000, 0x0000, 0x0000, 0x0000, 0x0000, 0x0000, 0x0000, 0x0000,
    0x0000, 0x0000, 0x0000, 0x0000, 0x0000, 0x0000, 0x0000, 0x0000, 0x0000, 0x0000, 0x0000, 0x0000, 0x0000, 0x0000, 0x0000, 0x0000,
    0x0000, 0x0000, 0x0000, 0x0000, 0x0000, 0x0000, 0x0000, 0x0000, 0x0000, 0x0000, 0x0000, 0x0000, 0x0000, 0x0000, 0x0000, 0x0000,
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    0x2820, 0xcb22, 0x22a4, 0x2bc5, 0x2bc5, 0x9b44, 0xba25, 0x6929, 0x614a, 0x79ca, 0xb226, 0xaae4, 0x3345, 0x23e5, 0x23e5, 0x23a5
};

const uint16_t logoB1 [] = {
    0x0000, 0x0000, 0x0000, 0x0000, 0x0000, 0x0000, 0x0000, 0x0000, 0x0000, 0x0000, 0x0000, 0x0000, 0x0000, 0x0000, 0x0000, 0x0000,
    0x0000, 0x0000, 0x0000, 0x0000, 0x0000, 0x0000, 0x0000, 0x0000, 0x0000, 0x0000, 0x0000, 0x0000, 0x0000, 0x0000, 0x0000, 0x0000,
    0x0000, 0x0000, 0x0000, 0x0000, 0x0000, 0x0000, 0x0000, 0x0000, 0x0000, 0x0000, 0x0000, 0x0000, 0x0000, 0x0000, 0x0000, 0x0000,
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    0xab43, 0xd2a2, 0x22e4, 0x2384, 0xc2a2, 0xa203, 0x23a5, 0x23a5, 0xc301, 0xba05, 0xdb42, 0x6323, 0x23c5, 0x2324, 0xcb01, 0x8100
};
const uint16_t logoB2 [] = {
    0x0000, 0x0000, 0x0000, 0x0000, 0x0000, 0x0000, 0x0000, 0x0000, 0x3040, 0x68e1, 0x0000, 0x0000, 0x0000, 0x0000, 0x0000, 0x0000,
    0x0000, 0x0000, 0x0000, 0x0000, 0x0000, 0x0000, 0x0000, 0x0000, 0x3840, 0xd302, 0xa9e2, 0x3860, 0x0000, 0x0000, 0x0000, 0x0000,
    0x0000, 0x0000, 0x0000, 0x0000, 0x0000, 0x0000, 0x0000, 0x0000, 0x3020, 0xb2c2, 0x8b03, 0xc321, 0x8921, 0x0800, 0x0000, 0x0000,
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    0x6304, 0x2385, 0xab43, 0xba22, 0x2345, 0x23c5, 0xb342, 0xb165, 0xd2c2, 0x5b04, 0x23c5, 0x2324, 0x2364, 0x2345, 0x82e4, 0xbac4
};
const uint16_t logoBR [] = {
    0x0000, 0x0000, 0x0000, 0x0000, 0x0000, 0x0000, 0x0000, 0x0000, 0x0000, 0x0000, 0x0000, 0x0000, 0x0000, 0x0000, 0x0000, 0x0000,
    0x0000, 0x0000, 0x0000, 0x0000, 0x0000, 0x0000, 0x0000, 0x0000, 0x0000, 0x0000, 0x0000, 0x0000, 0x0000, 0x0000, 0x0000, 0x0000,
    0x0000, 0x0000, 0x0000, 0x0000, 0x0000, 0x0000, 0x0000, 0x0000, 0x0000, 0x0000, 0x0000, 0x0000, 0x0000, 0x0000, 0x0000, 0x0000,
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    0x798a, 0x320d, 0x29cc, 0x4af0, 0xc263, 0x2305, 0x2345, 0xc2a2, 0xa262, 0x2366, 0x2306, 0xcb62, 0xbaa2, 0xdbc4, 0xb9a2, 0x1820
};

const uint16_t classic1 [] = {
    0x0000, 0x0000, 0x0000, 0x0000, 0x0000, 0x0000, 0x0000, 0x0000, 0x0000, 0x0000, 0x0000, 0x0000, 0x0000, 0x0000, 0x0000, 0x0000,
    0x0000, 0x0000, 0x1082, 0x31a6, 0x4208, 0x4208, 0x4208, 0x4208, 0x2945, 0x0000, 0x0000, 0x0000, 0x0000, 0x10a2, 0x39c7, 0x3186,
    0x0000, 0x0000, 0x4a49, 0xbdf7, 0xc638, 0xc618, 0xc618, 0xc618, 0x9492, 0x18c2, 0x0000, 0x0000, 0x0000, 0x52aa, 0xc618, 0xad75,
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    0x0000, 0x0000, 0x0000, 0x0000, 0x0000, 0x0000, 0x0000, 0x0000, 0x0000, 0x0000, 0x0000, 0x0000, 0x0000, 0x0000, 0x0000, 0x0000
};
const uint16_t classic2 [] = {
    0x0000, 0x0000, 0x0000, 0x0000, 0x0000, 0x0000, 0x0000, 0x0000, 0x0000, 0x0000, 0x0000, 0x0000, 0x0000, 0x0000, 0x0000, 0x0000,
    0x0020, 0x0000, 0x0020, 0x2965, 0x4208, 0x4208, 0x4208, 0x4208, 0x4208, 0x39e7, 0x2965, 0x0020, 0x2945, 0x39e7, 0x4207, 0x4207,
    0x18c3, 0x0000, 0x10a2, 0xa514, 0xc618, 0xc618, 0xc618, 0xbdf7, 0xbdf7, 0xc618, 0xa534, 0x0861, 0x94b2, 0xc618, 0xbdf7, 0xbdf7,
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    0x0000, 0x0000, 0x0000, 0x0000, 0x0000, 0x0000, 0x0000, 0x0000, 0x0000, 0x0000, 0x0000, 0x0000, 0x0000, 0x0000, 0x0000, 0x0000
};
const uint16_t classic3 [] = {
    0x0000, 0x0000, 0x0000, 0x0000, 0x0000, 0x0000, 0x0000, 0x0000, 0x0000, 0x0000, 0x0000, 0x0000, 0x0000, 0x0000, 0x0000, 0x0000,
    0x4207, 0x4207, 0x4207, 0x2965, 0x0840, 0x0000, 0x0020, 0x2965, 0x4208, 0x4208, 0x4208, 0x4208, 0x4228, 0x4208, 0x2965, 0x0000,
    0xbdf7, 0xbdf7, 0xbdf7, 0xad75, 0x1082, 0x0000, 0x10a2, 0x9cd3, 0xc618, 0xc638, 0xc618, 0xc618, 0xc638, 0xc638, 0xb596, 0x0861,
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    0x0000, 0x0000, 0x0000, 0x0000, 0x0000, 0x0000, 0x0000, 0x0000, 0x0000, 0x0000, 0x0000, 0x0000, 0x0000, 0x0000, 0x0000, 0x0000
};
const uint16_t classic4 [] = {
    0x0000, 0x0000, 0x0000, 0x0000, 0x0000, 0x0000, 0x0000, 0x0000, 0x0000, 0x0000, 0x0000, 0x0000, 0x0000, 0x0000, 0x0000, 0x0000,
    0x0000, 0x0841, 0x3186, 0x31a6, 0x1082, 0x0000, 0x0000, 0x2104, 0x39e7, 0x4208, 0x4208, 0x4208, 0x39c7, 0x10a2, 0x0000, 0x0000,
    0x0000, 0x2945, 0xa514, 0xc618, 0x8410, 0x0000, 0x0861, 0x6b6d, 0xc618, 0xc618, 0xc618, 0xc618, 0xc618, 0x9cd3, 0x0000, 0x0000,
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    0x0000, 0x0000, 0x0000, 0x0000, 0x0000, 0x0000, 0x0000, 0x0000, 0x0000, 0x0000, 0x0000, 0x0000, 0x0000, 0x0000, 0x0000, 0x0000
};

const uint16_t classic1selected [] = {
    0xffff, 0xffff, 0xffff, 0xffff, 0xffff, 0xffff, 0xffff, 0xffff, 0xffff, 0xffff, 0xffff, 0xffff, 0xffff, 0xffff, 0xffff, 0xffff,
    0xffff, 0xffff, 0xffff, 0xef5d, 0xdefb, 0xdefb, 0xdefb, 0xe71c, 0xf7be, 0xffff, 0xffff, 0xffff, 0xffff, 0xffff, 0xe73d, 0xf79e,
    0xffff, 0xffff, 0xffdf, 0x9cd3, 0x94b2, 0x94b2, 0x94b2, 0x94b2, 0xbdf7, 0xffff, 0xffff, 0xffff, 0xffff, 0xf7be, 0x9cd3, 0xb596,
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    0xffff, 0xffff, 0xffff, 0xffff, 0xffff, 0xffff, 0xffff, 0xffff, 0xffff, 0xffff, 0xffff, 0xffff, 0xffff, 0xffff, 0xffff, 0xffff
};



const uint16_t classic2selected [] = {
    0xffff, 0xffff, 0xffff, 0xffff, 0xffff, 0xffff, 0xffff, 0xffff, 0xffff, 0xffff, 0xffff, 0xffff, 0xffff, 0xffff, 0xffff, 0xffff,
    0xffff, 0xffff, 0xffff, 0xf7be, 0xe71c, 0xdefb, 0xdefb, 0xdefb, 0xdefb, 0xe71c, 0xf7be, 0xffff, 0xf7be, 0xe71c, 0xdefc, 0xdefc,
    0xffdf, 0xffff, 0xffff, 0xbdf7, 0x9cd3, 0x9cd3, 0x9cd3, 0x9cd3, 0x9cd3, 0x9cd3, 0xc618, 0xffff, 0xd69a, 0x9cd3, 0x9cd3, 0x9cd3,
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    0xffff, 0xffff, 0xffff, 0xffff, 0xffff, 0xffff, 0xffff, 0xffff, 0xffff, 0xffff, 0xffff, 0xffff, 0xffff, 0xffff, 0xffff, 0xffff
};

const uint16_t classic3selected [] = {
    0xffff, 0xffff, 0xffff, 0xffff, 0xffff, 0xffff, 0xffff, 0xffff, 0xffff, 0xffff, 0xffff, 0xffff, 0xffff, 0xffff, 0xffff, 0xffff,
    0xdefc, 0xdefc, 0xe71c, 0xf79e, 0xffff, 0xffff, 0xffff, 0xf79e, 0xdefc, 0xdefb, 0xdefb, 0xdefb, 0xdefb, 0xdefb, 0xf7be, 0xffff,
    0x9cd3, 0x9cd3, 0x9cd3, 0xad55, 0xffff, 0xffff, 0xffff, 0xbdf7, 0x9cd3, 0x9cd3, 0x9cd3, 0x9cd3, 0x94b2, 0x94b2, 0xb5b6, 0xffff,
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    0xffff, 0xffff, 0xffff, 0xffff, 0xffff, 0xffff, 0xffff, 0xffff, 0xffff, 0xffff, 0xffff, 0xffff, 0xffff, 0xffff, 0xffff, 0xffff
};

const uint16_t classic4selected [] = {
    0xffff, 0xffff, 0xffff, 0xffff, 0xffff, 0xffff, 0xffff, 0xffff, 0xffff, 0xffff, 0xffff, 0xffff, 0xffff, 0xffff, 0xffff, 0xffff,
    0xffff, 0xffff, 0xf79e, 0xef5d, 0xffff, 0xffff, 0xffff, 0xffdf, 0xe71c, 0xdefb, 0xdefb, 0xdefb, 0xe73c, 0xffff, 0xffff, 0xffff,
    0xffff, 0xf7be, 0xb5b6, 0x9cd3, 0xef7d, 0xffff, 0xffff, 0xd6ba, 0x94b2, 0x94b2, 0x94b2, 0x94b2, 0x94b2, 0xe73c, 0xffff, 0xffff,
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    0xffff, 0xffff, 0xffff, 0xffff, 0xffff, 0xffff, 0xffff, 0xffff, 0xffff, 0xffff, 0xffff, 0xffff, 0xffff, 0xffff, 0xffff, 0xffff
};
const uint16_t black [] = {
    0x0000, 0x0000, 0x0000, 0x0000, 0x0000, 0x0000, 0x0000, 0x0000, 0x0000, 0x0000, 0x0000, 0x0000, 0x0000, 0x0000, 0x0000, 0x0000,
    0x0000, 0x0000, 0x0000, 0x0000, 0x0000, 0x0000, 0x0000, 0x0000, 0x0000, 0x0000, 0x0000, 0x0000, 0x0000, 0x0000, 0x0000, 0x0000,
    0x0000, 0x0000, 0x0000, 0x0000, 0x0000, 0x0000, 0x0000, 0x0000, 0x0000, 0x0000, 0x0000, 0x0000, 0x0000, 0x0000, 0x0000, 0x0000,
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    0x0000, 0x0000, 0x0000, 0x0000, 0x0000, 0x0000, 0x0000, 0x0000, 0x0000, 0x0000, 0x0000, 0x0000, 0x0000, 0x0000, 0x0000, 0x0000
};








void Device_Init(void) {

    BSP_LCD_OutputInit();
    BSP_Joystick_Init();
}


//------------------Task 1--------------------------------
// background thread executed at 20 Hz
//******** Producer ***************
int UpdatePosition(uint16_t rawx, uint16_t rawy, jsDataType* data) {
    /*
    	if(startup == 0)
                {
                              //Set mode selection
    	if (rawy  > (origin[1] + 100))
    	{
    		//Classic Selected
    		 mode = 1;
    	}
    	if (rawy < (origin[1] - 100))
    	{
    		//Score Attack Selected
    			mode = 0;
    	}
    	return 1;
                }
                else{
    */
    if (rawx > origin[0]) {
        x = x + ((rawx - origin[0]) >> 9);
    }
    else {
        x = x - ((origin[0] - rawx) >> 9);
    }
    if (rawy < origin[1]) {
        y = y + ((origin[1] - rawy) >> 9);
    }
    else {
        y = y - ((rawy - origin[1]) >> 9);
    }
    if (x > 127) {
        x = 127;
    }
    if (x < 0) {
        x = 0;
    }
    if (y > 100) {
        y = 100;
    }
    if (y < 60) {
        y = 60;
    }
    data->x = x;
    data->y = y;
    return 1;
}
//}

void Producer(void) {

    uint16_t rawX,rawY; // raw adc value
    uint8_t select;
    jsDataType data;

    if (life > 0) {

        BSP_Joystick_Input(&rawX,&rawY,&select);                        // joystick input
        UpdatePosition(rawX,rawY,&data);                                                                                          // calculation work
        NumSamples++;                                                                                                                                              // number of samples
        CubeSamples++;                                                                                                                                                                                                                                              // number of cubesamples
        JsFifo_Put(data);                                                                                                                                                                                                                              // Send data to consumer
    }
}
//--------------end of Task 1-----------------------------

//------------------Task 2--------------------------------
// background thread executes with SW2 button
// one foreground task created with button push
// foreground treads run for 2 sec and die
// ***********ButtonWork*************
void ButtonWork(void) {
    if(startup == 0)
    {
        startup = 1;
        //Set mode
        //Kill Splash
        //Start Game
    }
    else {
        //This is just a POC and will be replaced
        if(shotnum < 1)
        {
            OS_bWait(&LCDFree);
            NumCreated += OS_AddThread(&PlayerShot, 128, 1);
            OS_bSignal(&LCDFree);
            Shot.position[0] = x;
            Shot.position[1] = y;
            shotnum++;
        }
        else
        {
            shotnum = 0;
        }
    }

    //uint32_t StartTime,CurrentTime,ElapsedTime;
    //StartTime = OS_MsTime();
    //ElapsedTime = 0;
    //Button1RespTime = OS_MsTime() - Button1PushTime; // LCD Response here
    //BSP_LCD_FillScreen(BGCOLOR);
    //Button1FuncTime = OS_MsTime() - Button1PushTime;
    //Button1PushTime = 0;
    //while (ElapsedTime < LIFETIME){
    //CurrentTime = OS_MsTime();
    //ElapsedTime = CurrentTime - StartTime;
    //BSP_LCD_Message(0,5,0,"Life Time:",LIFETIME);
    //BSP_LCD_Message(1,0,0,"Horizontal Area:",area[0]);
    //BSP_LCD_Message(1,1,0,"Vertical Area:",area[1]);
    //BSP_LCD_Message(1,2,0,"Elapsed Time:",ElapsedTime);
    //OS_Sleep(50);

    //}
    //BSP_LCD_FillScreen(BGCOLOR);
    OS_Kill();  // done, OS does not return from a Kill
}


//************SW2Push*************
// Called when SW2 Button pushed
// Adds another foreground task
// background threads execute once and return
void SW2Push(void) {

    if(OS_MsTime() > 20 ) { // debounce
        if(OS_AddThread(&ButtonWork, 128, 4)) {
            NumCreated++;
        }
        OS_ClearMsTime();  // at least 20ms between touches
    }
}


//------------------Task 3--------------------------------

//******** Consumer ***************
// foreground thread, accepts data from producer
// Display crosshair and its positions
// inputs:  none
// outputs: none
int ShipCollision(void);
void Consumer(void) {

    OS_bWait(&blockConsumer);
    life = 3;
    while(life > 0) {

        if(startup == 0)
        {
            //Joystick up is classic
            //Joystick down is score attack
        }
        else {

            jsDataType data;
            JsFifo_Get(&data);
            OS_bWait(&LCDFree);

            OS_bWait(&Trace1);
            BSP_LCD_Message(1, 5, 0, "Score:", score);
            BSP_LCD_Message(1, 5, 11, "Life:", life);
            OS_bSignal(&Trace1);
            //BSP_LCD_DrawCrosshair(prevx, prevy, LCD_BLACK); // Draw a black crosshair
            //BSP_LCD_DrawCrosshair(data.x, data.y, LCD_RED); // Draw a red crosshair

            BSP_LCD_DrawBitmap(prevx - 8, prevy + 8,black, 16, 16);
            BSP_LCD_DrawBitmap(data.x - 8, data.y + 8,ship, 16, 16);
            ShipCollision();
            OS_bSignal(&LCDFree);
            prevx = data.x;
            prevy = data.y;
        }

        OS_bSignal(&blockConsumer);
        continue;
    }
//OS_bSignal(&blockConsumer);
    OS_Kill();  // done
}
//--------------end of Task 3-----------------------------


// Random Number Generator (used website referenced in project document -> https://www.maximintegrated.com/cn/app-notes/index.mvp/id/4400)

typedef unsigned int uint;
uint lfsr31, lfsr32;

int shift_lfsr(uint *lfsr, uint polynomial_mask) {
    int feedback;

    feedback = *lfsr &1;
    *lfsr >>= 1;
    if(feedback == 1)
        *lfsr ^= polynomial_mask;
    return *lfsr;
}

void init_lfsrs(void) {
    lfsr32 = 0xABCDEFAB; // 1st Seed Value
    lfsr31 = NVIC_ST_CURRENT_R; // 2nd Seed Value
}

int RandomCube(void) { // return random number from 0 - 5 that corresponds to the amount of cubes on the LCD screen
    shift_lfsr(&lfsr32, POLY_MASK_32);
    return ((shift_lfsr(&lfsr32, POLY_MASK_32) ^ shift_lfsr(&lfsr31, POLY_MASK_31)) & 0xFFFF) % 6;
}

int Random(void) { // returns random number from 0 - 4 that will correspond to ....
    shift_lfsr(&lfsr32, POLY_MASK_32); // random number from 0-1
    return ((shift_lfsr(&lfsr32, POLY_MASK_32) ^ shift_lfsr(&lfsr31, POLY_MASK_31)) & 0xFFFF) % 2;
}

int RandomDirection(void) { // returns random number from 0 - 3 that will correspond to the direction the cube will move next
    shift_lfsr(&lfsr32, POLY_MASK_32);
    return ((shift_lfsr(&lfsr32, POLY_MASK_32) ^ shift_lfsr(&lfsr31, POLY_MASK_31)) & 0xFFFF) % 4;
}

int RandomColor(void) {  // returns random number from 0 - 7 that will correspond to the index of the global array that contains the colors
    shift_lfsr(&lfsr32, POLY_MASK_32);
    return ((shift_lfsr(&lfsr32, POLY_MASK_32) ^ shift_lfsr(&lfsr31, POLY_MASK_31)) & 0xFFFF) % 8;
}


// Block Array (2D array that holds the row and column that each cube is located)
// The Block Array breaks apart the screen into a grid of possible cube locations
// The values held in the array correspond to the row and column in which a cube is located
// This is using the BlockFree semaphore provided in the porject document block struct
void Splash(void);
//------------------Task 6--------------------------------
// background thread executes with button2
// one foreground task created with button push
// ***********ButtonWork2*************

void Restart(void) {

    long StartTime,CurrentTime,ElapsedTime;
    int i;
    OS_bWait(&blockConsumer);
    x =63;
    y = 63;
    for(i = 0; i < enemyNum; i++) {
        enemyArray[i].alive = 0;
    }
    enemyNumber = 0;
    life = 0; // first kill the foreground threads
    OS_Sleep(50); // wait
    score = 0;
    StartTime = OS_MsTime();
    ElapsedTime = 0;
    startup = 0;


    OS_bWait(&LCDFree);
    BSP_LCD_FillScreen(BGCOLOR);

    while (ElapsedTime < 1000) {
        CurrentTime = OS_MsTime();
        ElapsedTime = CurrentTime - StartTime;
        BSP_LCD_DrawString(4,6,"- Game Over -",LCD_BLUE);
    }

    BSP_LCD_FillScreen(BGCOLOR);
    //BSP_LCD_Message(1, 5, 0, "Score:", score);
    //BSP_LCD_Message(1, 5, 11, "Life:", life);
    OS_bSignal(&LCDFree);

    NumSamples = 0;
    CubeSamples = 0;
    CubeCount = 0;
    NumCreated = 0;

    x = 63;
    y = 63;

    // NumCreated += OS_AddThread(&Consumer, 128, 1);
    //OS_AddPeriodicThread(&Producer,PERIOD,3);
    NumCreated += OS_AddThread(&Splash, 128, 2);
    OS_bSignal(&blockConsumer);


    OS_Kill();  // done, OS does not return from a Kill
}



void Info(void);
//************SW1Push*************
// Called when Button1 pushed
// Adds another foreground task
// background threads execute once and return
void SW1Push(void) {
    if(OS_MsTime() > 20 ) { // debounce
        if(insplash == 1)
        {
            OS_AddThread(&Info,128,1);
            NumCreated++;
            insplash = 0;
        }
    }
}
//--------------end of Task 6-----------------------------


void DrawEnemy(int xpos,int ypos, int i) {
    // Draw single enemy
    OS_bWait(&LCDFree);
    BSP_LCD_DrawBitmap(xpos, ypos, enemyArray[i].color,16,16);
    OS_bSignal(&LCDFree);

}

void EraseEnemy(int xpos,int ypos) {


    // Draw single enemy
    OS_bWait(&LCDFree);
    BSP_LCD_DrawBitmap(xpos, ypos, black,16,16);
    OS_bSignal(&LCDFree);

}

int HitEnemy() {

    int i;

    for(i = 0; i < enemyNum; i++)
    {
        if(((Shot.position[0] > enemyArray[i].position[0]) && (Shot.position[1]< enemyArray[i].position[1])) && ((Shot.position[0] < enemyArray[i].position[0]+16) && (Shot.position[1]< enemyArray[i].position[1])) && (shotnum > 0) && (enemyArray[i].alive))
        {
            OS_bWait(&Trace);
            enemyArray[i].alive = 0;
            EraseEnemy(enemyArray[i].position[0],enemyArray[i].position[1]);
            shotnum--;
            score++;
            enemyNumber--;
            Shot.position[1] = -50;
            flaggin = 1;
            OS_bSignal(&Trace);
            return 1;
        }
    }
    return 0;
}
int ShipCollision() {
    int i;
    for(i=0; i<enemyNum; i++) {
        if((abs((x)-(enemyArray[i].position[0]+8)) < 14) && (abs((y)-(enemyArray[i].position[1]-8)) < 14)&&(enemyArray[i].alive)) {
            //OS_bWait(&Trace);
            //enemyArray[i].alive = 0;
            //EraseEnemy(enemyArray[i].position[0],enemyArray[i].position[1]);
            life = 0;
            enemyArray[i].alive = 0;
            //shotnum--;
            //score++;
            //enemyNumber--;
            //Shot.position[1] = -50;
            //flaggin = 1;
            //OS_bSignal(&Trace);
            return 1;
        }
    }
    return 0;
}



void initEnemies(void);
void OS_DisableInterrupts(void);	// Disable interrupts
void OS_EnableInterrupts(void);  	// Enable interrupts

//Info
void Info(void)
{
    long timer = 0;
    OS_bWait(&LCDFree);
    BSP_LCD_FillScreen(BGCOLOR);
    while (timer < 250)
    {
        BSP_LCD_DrawString(1,2,"Galaga Score Attack",LCD_WHITE);
        BSP_LCD_DrawString(10,3,"by",LCD_WHITE);
        BSP_LCD_DrawString(4,4,"Jon Gustafson",LCD_WHITE);
        BSP_LCD_DrawString(4,5,"Justin Javier",LCD_WHITE);
        BSP_LCD_DrawString(5,6,"Trace LaCour",LCD_WHITE);
        BSP_LCD_DrawString(6,7,"Josh Neal",LCD_WHITE);
        OS_DisableInterrupts();	// Disable interrupts
        timer++;
    }
    BSP_LCD_FillScreen(BGCOLOR);
    OS_bSignal(&LCDFree);
    OS_EnableInterrupts();
    //Restart();
    OS_Kill();
}

//ScoreAttack
void Game()
{
    int i;
    int temp = 0;
	  int timer = 0;
	  life = 3;
    //initEnemies();
	
	
if(start == 1)
	{
		while(timer < 500)
		{

		OS_bWait(&LCDFree);
		BSP_LCD_DrawString(7,3,"-START-",LCD_WHITE);
		timer++;
			OS_bSignal(&LCDFree);
		}
		
		OS_bWait(&LCDFree);
		start = 0;

		BSP_LCD_FillRect(0,29,120,10,LCD_BLACK);
		OS_bSignal(&LCDFree);
	}


    while(life > 0)
    {

        initEnemies();

        for(i = 0; i < enemyNum; i++)
        {

            OS_bWait(&Trace);
            if(enemyArray[i].alive && !flaggin)
            {
                temp++;

                while(temp <= 100000) {
                    temp++;
                }
                temp = 0;

                EraseEnemy(enemyArray[i].position[0],enemyArray[i].position[1]);
                enemyArray[i].position[1] += 1;

                if(enemyArray[i].position[1] >= 120) {

                    OS_bWait(&Trace1);
                    enemyArray[i].alive = 0;
                    life--;
                    enemyNumber--;
                    OS_bSignal(&Trace1);
                }
                else
                {
                    DrawEnemy(enemyArray[i].position[0],enemyArray[i].position[1], i);
                }
            }

            else if(enemyArray[i].alive && flaggin) {

                EraseEnemy(enemyArray[i].position[0],enemyArray[i].position[1]);
                flaggin = 0;
            }
            OS_bSignal(&Trace);
        }



        OS_Suspend();
    }

    OS_Suspend();
    Restart();
    OS_Kill();
}

void CrossHair_Init(void) {
    BSP_LCD_FillScreen(BGCOLOR);
    BSP_Joystick_Input(&origin[0],&origin[1],&select);
}

void PeriodicUpdater(void)
{
    while(1);
}

void HUD_Init(void) {

    BSP_LCD_Message(1, 5, 0, "Score:", score);
    BSP_LCD_Message(1, 5, 11, "Life:", life);
}


void PlayerShot(void) { //WIP

    int count = 0;
    int shotx = Shot.position[0];
    int shoty = Shot.position[1];

    if(shotnum == 1)
    {
        while((shoty) > -20)
        {

            shoty = Shot.position[1];
            if(HitEnemy()) {
                OS_bWait(&LCDFree);

                //BSP_LCD_DrawFastVLine(shotx+4, shoty+4, 4, LCD_BLACK);
                BSP_LCD_DrawFastVLine(shotx, shoty-4, 4, LCD_BLACK);

                OS_bSignal(&LCDFree);

                break;
            }
            OS_bWait(&LCDFree);

            //BSP_LCD_DrawFastVLine(shotx+4, shoty, 4, LCD_RED);
            BSP_LCD_DrawFastVLine(shotx, shoty-12, 4, LCD_RED);

            //BSP_LCD_DrawFastVLine(shotx+4, shoty+4, 4, LCD_BLACK);
            BSP_LCD_DrawFastVLine(shotx, shoty-8, 4, LCD_BLACK);

            //BSP_LCD_DrawBitmap(shotx,shoty ,playershot, 16, 16);
            //BSP_LCD_DrawBitmap(shotx,shoty,black, 16, 16);

            Shot.position[1]--;
            OS_bSignal(&LCDFree);
            count = 0;

            while (count < 5000)
            {
                count++;
            }
        }
        shotnum = 0;
    }
    OS_Kill();

};

void initEnemies(void);

void Splash(void) {

    int vertical = 47;
    int horizontal = 31;
		start = 1;

    //OS_AddPeriodicThread(&Producer,PERIOD,3); // 2 kHz real time sampling of PD3

    BSP_LCD_FillScreen(BGCOLOR);

    while(startup == 0)
    {
        insplash = 1;
        OS_bWait(&LCDFree);
        //Top of Logo
        BSP_LCD_DrawBitmap(horizontal,vertical,logoTL, 16, 16);
        BSP_LCD_DrawBitmap(horizontal+16,vertical,logoT1, 16, 16);
        BSP_LCD_DrawBitmap(horizontal+32,vertical,logoT2, 16, 16);
        BSP_LCD_DrawBitmap(horizontal+48,vertical,logoTR, 16, 16);

        //Bottom of logo
        BSP_LCD_DrawBitmap(horizontal,vertical+16,logoBL, 16, 16);
        BSP_LCD_DrawBitmap(horizontal+16,vertical+16,logoB1, 16, 16);
        BSP_LCD_DrawBitmap(horizontal+32,vertical+16,logoB2, 16, 16);
        BSP_LCD_DrawBitmap(horizontal+48,vertical+16,logoBR, 16, 16);
        OS_bSignal(&LCDFree);

        /*
        //Intial Writes
        OS_bWait(&LCDFree);
        BSP_LCD_DrawBitmap(horizontal,vertical+48,classic1, 16, 16);
        BSP_LCD_DrawBitmap(horizontal+16,vertical+48,classic2, 16, 16);
        BSP_LCD_DrawBitmap(horizontal+32,vertical+48,classic3, 16, 16);
        BSP_LCD_DrawBitmap(horizontal+48,vertical+48,classic4, 16, 16);
        OS_bSignal(&LCDFree);
        */
        //Info
        OS_bWait(&LCDFree);
        BSP_LCD_DrawString(1, 9,"  Press B for Info",LCD_WHITE);
        //BSP_LCD_DrawString(0,1,"SW2: Confirm",LCD_WHITE);
        BSP_LCD_DrawString(1,8,"  Press A to Start",LCD_WHITE);
        OS_bSignal(&LCDFree);




        //Classic Mode
        /*
        // Not Selected
        if(mode == 1)
        {
        	OS_bWait(&LCDFree);
        	BSP_LCD_DrawBitmap(horizontal,vertical+48,classic1selected, 16, 16);
        	BSP_LCD_DrawBitmap(horizontal+16,vertical+48,classic2selected, 16, 16);
        	BSP_LCD_DrawBitmap(horizontal+32,vertical+48,classic3selected, 16, 16);
        	BSP_LCD_DrawBitmap(horizontal+48,vertical+48,classic4selected, 16, 16);
        	OS_bSignal(&LCDFree);
        }
        else
        {//Classic
        	OS_bWait(&LCDFree);
        	BSP_LCD_DrawBitmap(horizontal,vertical+48,classic1, 16, 16);
        	BSP_LCD_DrawBitmap(horizontal+16,vertical+48,classic2, 16, 16);
        	BSP_LCD_DrawBitmap(horizontal+32,vertical+48,classic3, 16, 16);
        	BSP_LCD_DrawBitmap(horizontal+48,vertical+48,classic4, 16, 16);
        	OS_bSignal(&LCDFree);
        	//ScoreAttack selected
        }
        	*/
    }


    OS_bWait(&LCDFree);
    BSP_LCD_FillScreen(BGCOLOR);
    OS_bSignal(&LCDFree);


    HUD_Init();
    /*
    	if(mode ==1)
    	{
    	NumCreated += OS_AddThread(&Game,128, 3);
    	NumCreated += OS_AddThread(&Consumer,128, 1);
    	insplash = 0;
    	}
    	else
    	{
    		NumCreated += OS_AddThread(&Game,128, 3);
    		NumCreated += OS_AddThread(&Consumer,128, 1);
    		insplash = 0;
    	}
    	*/
    NumCreated += OS_AddThread(&Game,128, 3);
    NumCreated += OS_AddThread(&Consumer,128, 1);
		insplash = 0;
    OS_Kill();
}


void initEnemies() {


    if(enemyNumber == 0) {
        int checker;
        int temp = RandomColor();
        enemyArray[temp].color = &enemies[RandomDirection()-1][256];
        enemyArray[temp].position[0] = temp*16;
        enemyArray[temp].position[1] = 16;

        checker = Random();
        enemyArray[temp].alive = checker;

        if(checker == 1) {
            enemyNumber++;
        }
    }
}



//*******************final user main DEMONTRATE THIS TO TA**********
int main(void) {
    OS_Init();           // initialize, disable interrupts
    Device_Init();
    CrossHair_Init();
    init_lfsrs();
    JsFifo_Init();

    //HUD_Init();

    NumCreated = 0;
    CubeCount = 0;
    NumSamples = 0;
    CubeSamples = 0;
    startup = 0;

    life = 3;
    score = 0;

    OS_InitSemaphore(&Trace, 1);
    OS_InitSemaphore(&Trace1, 1);
    OS_InitSemaphore(&blockConsumer,1);

    // create interrupt driven button task as well as periodic producer
    OS_AddSW2Task(&SW2Push,4);
    OS_AddSW1Task(&SW1Push,4);
    OS_AddPeriodicThread(&Producer,PERIOD,3); // 2 kHz real time sampling of PD3

    // create initial foreground threads
    NumCreated += OS_AddThread(&Splash, 128, 5);
    NumCreated += OS_AddThread(&PeriodicUpdater, 128, 4);

    OS_Launch(TIME_1MS); // doesn't return, interrupts enabled in here
    return 0;            // this never executes
}
